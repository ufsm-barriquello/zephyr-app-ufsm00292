## APP_NICOLAS/APP_NICOLAS/build/Kconfig/Kconfig.modules
```kconfig
menu "cmsis_6 (/mnt/dados/zephyr/modules/hal/cmsis_6)"
osource "$(ZEPHYR_CMSIS_6_KCONFIG)"
config ZEPHYR_CMSIS_6_MODULE
	bool
	default y
endmenu
config ZEPHYR_ATMEL_MODULE
	bool
	default y
menu "hal_nordic (/mnt/dados/zephyr/modules/hal/nordic)"
osource "$(ZEPHYR_HAL_NORDIC_KCONFIG)"
config ZEPHYR_HAL_NORDIC_MODULE
	bool
	default y

config ZEPHYR_HAL_NORDIC_MODULE_BLOBS
	bool
endmenu
config ZEPHYR_HAL_STM32_MODULE
	bool
	default y

config ZEPHYR_HAL_STM32_MODULE_BLOBS
	bool
```

## APP_NICOLAS/APP_NICOLAS/build/Kconfig/arch/Kconfig
```kconfig
# Load Zephyr Arch Kconfig descriptions.
osource "/mnt/dados/zephyr/zephyr/arch/rx/Kconfig"
osource "/mnt/dados/zephyr/zephyr/arch/x86/Kconfig"
osource "/mnt/dados/zephyr/zephyr/arch/xtensa/Kconfig"
osource "/mnt/dados/zephyr/zephyr/arch/sparc/Kconfig"
osource "/mnt/dados/zephyr/zephyr/arch/riscv/Kconfig"
osource "/mnt/dados/zephyr/zephyr/arch/posix/Kconfig"
osource "/mnt/dados/zephyr/zephyr/arch/mips/Kconfig"
osource "/mnt/dados/zephyr/zephyr/arch/arm64/Kconfig"
osource "/mnt/dados/zephyr/zephyr/arch/arm/Kconfig"
osource "/mnt/dados/zephyr/zephyr/arch/arc/Kconfig"
```

## APP_NICOLAS/APP_NICOLAS/build/Kconfig/boards/Kconfig
```kconfig
# Load Zephyr board Kconfig descriptions.
osource "/mnt/dados/zephyr/zephyr/boards/native/native_sim/Kconfig"
```

## APP_NICOLAS/APP_NICOLAS/build/Kconfig/boards/Kconfig.defconfig
```kconfig
# Load Zephyr board defconfig descriptions.
osource "/mnt/dados/zephyr/zephyr/boards/atmel/sam0/samr21_xpro/Kconfig.defconfig"
```

## APP_NICOLAS/APP_NICOLAS/build/Kconfig/boards/Kconfig.native_sim
```kconfig
# Load board Kconfig descriptions.
osource "/mnt/dados/zephyr/zephyr/boards/native/native_sim/Kconfig.native_sim"
```

## APP_NICOLAS/APP_NICOLAS/build/Kconfig/boards/Kconfig.samr21_xpro
```kconfig
# Load board Kconfig descriptions.
osource "/mnt/dados/zephyr/zephyr/boards/atmel/sam0/samr21_xpro/Kconfig.samr21_xpro"
```

## APP_NICOLAS/APP_NICOLAS/build/Kconfig/boards/Kconfig.sysbuild
```kconfig
# Load Sysbuild board Kconfig descriptions.
osource "/mnt/dados/zephyr/zephyr/boards/atmel/sam0/samr21_xpro/Kconfig.sysbuild"
```

## APP_NICOLAS/APP_NICOLAS/build/Kconfig/soc/Kconfig
```kconfig
# Load Zephyr SoC Kconfig descriptions.
osource "/mnt/dados/zephyr/zephyr/soc/xlnx/zynqmp/Kconfig"
osource "/mnt/dados/zephyr/zephyr/soc/xlnx/zynq7000/Kconfig"
osource "/mnt/dados/zephyr/zephyr/soc/xlnx/versalnet/Kconfig"
osource "/mnt/dados/zephyr/zephyr/soc/xlnx/versal2/Kconfig"
osource "/mnt/dados/zephyr/zephyr/soc/xen/Kconfig"
osource "/mnt/dados/zephyr/zephyr/soc/wch/ch32v/Kconfig"
osource "/mnt/dados/zephyr/zephyr/soc/ti/simplelink/Kconfig"
osource "/mnt/dados/zephyr/zephyr/soc/ti/mspm0/Kconfig"
osource "/mnt/dados/zephyr/zephyr/soc/ti/lm3s6965/Kconfig"
osource "/mnt/dados/zephyr/zephyr/soc/ti/k3/Kconfig"
osource "/mnt/dados/zephyr/zephyr/soc/telink/tlsr/Kconfig"
osource "/mnt/dados/zephyr/zephyr/soc/starfive/jh71xx/Kconfig"
osource "/mnt/dados/zephyr/zephyr/soc/st/stm32/Kconfig"
osource "/mnt/dados/zephyr/zephyr/soc/snps/qemu_arc/Kconfig"
osource "/mnt/dados/zephyr/zephyr/soc/snps/nsim/arc_v/Kconfig"
osource "/mnt/dados/zephyr/zephyr/soc/snps/nsim/arc_classic/Kconfig"
osource "/mnt/dados/zephyr/zephyr/soc/snps/hsdk4xd/Kconfig"
osource "/mnt/dados/zephyr/zephyr/soc/snps/hsdk/Kconfig"
osource "/mnt/dados/zephyr/zephyr/soc/snps/emsk/Kconfig"
osource "/mnt/dados/zephyr/zephyr/soc/snps/emsdp/Kconfig"
osource "/mnt/dados/zephyr/zephyr/soc/snps/arc_iot/Kconfig"
osource "/mnt/dados/zephyr/zephyr/soc/silabs/Kconfig"
osource "/mnt/dados/zephyr/zephyr/soc/sifli/sf32/Kconfig"
osource "/mnt/dados/zephyr/zephyr/soc/sifive/sifive_freedom/Kconfig"
osource "/mnt/dados/zephyr/zephyr/soc/sensry/Kconfig"
osource "/mnt/dados/zephyr/zephyr/soc/rockchip/Kconfig"
osource "/mnt/dados/zephyr/zephyr/soc/renode/riscv_virtual/Kconfig"
osource "/mnt/dados/zephyr/zephyr/soc/renode/cortex_r8_virtual/Kconfig"
osource "/mnt/dados/zephyr/zephyr/soc/renesas/smartbond/Kconfig"
osource "/mnt/dados/zephyr/zephyr/soc/renesas/rz/Kconfig"
osource "/mnt/dados/zephyr/zephyr/soc/renesas/rx/Kconfig"
osource "/mnt/dados/zephyr/zephyr/soc/renesas/rcar/Kconfig"
osource "/mnt/dados/zephyr/zephyr/soc/renesas/ra/Kconfig"
osource "/mnt/dados/zephyr/zephyr/soc/realtek/ec/Kconfig"
osource "/mnt/dados/zephyr/zephyr/soc/raspberrypi/rpi_pico/Kconfig"
osource "/mnt/dados/zephyr/zephyr/soc/quicklogic/eos_s3/Kconfig"
osource "/mnt/dados/zephyr/zephyr/soc/qemu/virt_riscv/Kconfig"
osource "/mnt/dados/zephyr/zephyr/soc/qemu/malta/Kconfig"
osource "/mnt/dados/zephyr/zephyr/soc/openisa/rv32m1/Kconfig"
osource "/mnt/dados/zephyr/zephyr/soc/openhwgroup/cva6/Kconfig"
osource "/mnt/dados/zephyr/zephyr/soc/oct/osd32mp15x/Kconfig"
osource "/mnt/dados/zephyr/zephyr/soc/nxp/s32/Kconfig"
osource "/mnt/dados/zephyr/zephyr/soc/nxp/rw/Kconfig"
osource "/mnt/dados/zephyr/zephyr/soc/nxp/mcx/Kconfig"
osource "/mnt/dados/zephyr/zephyr/soc/nxp/lpc/Kconfig"
osource "/mnt/dados/zephyr/zephyr/soc/nxp/layerscape/Kconfig"
osource "/mnt/dados/zephyr/zephyr/soc/nxp/kinetis/Kconfig"
osource "/mnt/dados/zephyr/zephyr/soc/nxp/imxrt/Kconfig"
osource "/mnt/dados/zephyr/zephyr/soc/nxp/imx/Kconfig"
osource "/mnt/dados/zephyr/zephyr/soc/nuvoton/numicro/Kconfig"
osource "/mnt/dados/zephyr/zephyr/soc/nuvoton/numaker/Kconfig"
osource "/mnt/dados/zephyr/zephyr/soc/nuvoton/npcx/Kconfig"
osource "/mnt/dados/zephyr/zephyr/soc/nuvoton/npcm/Kconfig"
osource "/mnt/dados/zephyr/zephyr/soc/nordic/Kconfig"
osource "/mnt/dados/zephyr/zephyr/soc/neorv32/Kconfig"
osource "/mnt/dados/zephyr/zephyr/soc/native/inf_clock/Kconfig"
osource "/mnt/dados/zephyr/zephyr/soc/microchip/sam/Kconfig"
osource "/mnt/dados/zephyr/zephyr/soc/microchip/sam/sama7/Kconfig"
osource "/mnt/dados/zephyr/zephyr/soc/microchip/sam/sam_d5x_e5x/Kconfig"
osource "/mnt/dados/zephyr/zephyr/soc/microchip/pic32c/pic32cz_ca/Kconfig"
osource "/mnt/dados/zephyr/zephyr/soc/microchip/pic32c/pic32cx_sg/Kconfig"
osource "/mnt/dados/zephyr/zephyr/soc/microchip/pic32c/pic32cm_jh/Kconfig"
osource "/mnt/dados/zephyr/zephyr/soc/microchip/miv/Kconfig"
osource "/mnt/dados/zephyr/zephyr/soc/microchip/mec/Kconfig"
osource "/mnt/dados/zephyr/zephyr/soc/mediatek/mt8xxx/Kconfig"
osource "/mnt/dados/zephyr/zephyr/soc/lowrisc/opentitan/Kconfig"
osource "/mnt/dados/zephyr/zephyr/soc/litex/litex_vexriscv/Kconfig"
osource "/mnt/dados/zephyr/zephyr/soc/ite/ec/Kconfig"
osource "/mnt/dados/zephyr/zephyr/soc/intel/wildcat_lake/Kconfig"
osource "/mnt/dados/zephyr/zephyr/soc/intel/raptor_lake/Kconfig"
osource "/mnt/dados/zephyr/zephyr/soc/intel/panther_lake/Kconfig"
osource "/mnt/dados/zephyr/zephyr/soc/intel/lakemont/Kconfig"
osource "/mnt/dados/zephyr/zephyr/soc/intel/intel_socfpga_std/Kconfig"
osource "/mnt/dados/zephyr/zephyr/soc/intel/intel_socfpga/Kconfig"
osource "/mnt/dados/zephyr/zephyr/soc/intel/intel_niosv/Kconfig"
osource "/mnt/dados/zephyr/zephyr/soc/intel/intel_ish/Kconfig"
osource "/mnt/dados/zephyr/zephyr/soc/intel/intel_adsp/Kconfig"
osource "/mnt/dados/zephyr/zephyr/soc/intel/elkhart_lake/Kconfig"
osource "/mnt/dados/zephyr/zephyr/soc/intel/atom/Kconfig"
osource "/mnt/dados/zephyr/zephyr/soc/intel/apollo_lake/Kconfig"
osource "/mnt/dados/zephyr/zephyr/soc/intel/alder_lake/Kconfig"
osource "/mnt/dados/zephyr/zephyr/soc/infineon/edge/Kconfig"
osource "/mnt/dados/zephyr/zephyr/soc/infineon/cat3/Kconfig"
osource "/mnt/dados/zephyr/zephyr/soc/infineon/cat1c/Kconfig"
osource "/mnt/dados/zephyr/zephyr/soc/infineon/cat1b/Kconfig"
osource "/mnt/dados/zephyr/zephyr/soc/infineon/cat1a/Kconfig"
osource "/mnt/dados/zephyr/zephyr/soc/gd/gd32/Kconfig"
osource "/mnt/dados/zephyr/zephyr/soc/gaisler/leon3/Kconfig"
osource "/mnt/dados/zephyr/zephyr/soc/gaisler/gr716a/Kconfig"
osource "/mnt/dados/zephyr/zephyr/soc/espressif/Kconfig"
osource "/mnt/dados/zephyr/zephyr/soc/ene/kb1200/Kconfig"
osource "/mnt/dados/zephyr/zephyr/soc/ene/kb106x/Kconfig"
osource "/mnt/dados/zephyr/zephyr/soc/egis/Kconfig"
osource "/mnt/dados/zephyr/zephyr/soc/efinix/sapphire/Kconfig"
osource "/mnt/dados/zephyr/zephyr/soc/cdns/xtensa_sample_controller/Kconfig"
osource "/mnt/dados/zephyr/zephyr/soc/cdns/sample_controller32/Kconfig"
osource "/mnt/dados/zephyr/zephyr/soc/cdns/dc233c/Kconfig"
osource "/mnt/dados/zephyr/zephyr/soc/brcm/bcmvk/Kconfig"
osource "/mnt/dados/zephyr/zephyr/soc/brcm/bcm2712/Kconfig"
osource "/mnt/dados/zephyr/zephyr/soc/brcm/bcm2711/Kconfig"
osource "/mnt/dados/zephyr/zephyr/soc/bflb/Kconfig"
osource "/mnt/dados/zephyr/zephyr/soc/atmel/sam0/Kconfig"
osource "/mnt/dados/zephyr/zephyr/soc/atmel/sam/Kconfig"
osource "/mnt/dados/zephyr/zephyr/soc/aspeed/Kconfig"
osource "/mnt/dados/zephyr/zephyr/soc/arm/Kconfig"
osource "/mnt/dados/zephyr/zephyr/soc/arm/beetle/Kconfig"
osource "/mnt/dados/zephyr/zephyr/soc/antmicro/myra/Kconfig"
osource "/mnt/dados/zephyr/zephyr/soc/andestech/Kconfig"
osource "/mnt/dados/zephyr/zephyr/soc/amd/acp_6_0/Kconfig"
osource "/mnt/dados/zephyr/zephyr/soc/ambiq/Kconfig"
osource "/mnt/dados/zephyr/zephyr/soc/aesc/Kconfig"
osource "/mnt/dados/zephyr/zephyr/soc/adi/max32/Kconfig"
```

## APP_jpsouto/build/Kconfig/arch/Kconfig
```kconfig
# Load Zephyr Arch Kconfig descriptions.
osource "/mnt/c/zephyrproject/zephyr/arch/rx/Kconfig"
osource "/mnt/c/zephyrproject/zephyr/arch/x86/Kconfig"
osource "/mnt/c/zephyrproject/zephyr/arch/xtensa/Kconfig"
osource "/mnt/c/zephyrproject/zephyr/arch/sparc/Kconfig"
osource "/mnt/c/zephyrproject/zephyr/arch/riscv/Kconfig"
osource "/mnt/c/zephyrproject/zephyr/arch/posix/Kconfig"
osource "/mnt/c/zephyrproject/zephyr/arch/mips/Kconfig"
osource "/mnt/c/zephyrproject/zephyr/arch/arm64/Kconfig"
osource "/mnt/c/zephyrproject/zephyr/arch/arm/Kconfig"
osource "/mnt/c/zephyrproject/zephyr/arch/arc/Kconfig"
```

## APP_jpsouto/build/Kconfig/boards/Kconfig
```kconfig
# Load Zephyr board Kconfig descriptions.
osource "/mnt/c/zephyrproject/zephyr/boards/atmel/sam0/samr21_xpro/Kconfig"
```

## APP_jpsouto/build/Kconfig/boards/Kconfig.defconfig
```kconfig
# Load Zephyr board defconfig descriptions.
osource "/mnt/c/zephyrproject/zephyr/boards/atmel/sam0/samr21_xpro/Kconfig.defconfig"
```

## APP_jpsouto/build/Kconfig/boards/Kconfig.samr21_xpro
```kconfig
# Load board Kconfig descriptions.
osource "/mnt/c/zephyrproject/zephyr/boards/atmel/sam0/samr21_xpro/Kconfig.samr21_xpro"
```

## APP_jpsouto/build/Kconfig/boards/Kconfig.sysbuild
```kconfig
# Load Sysbuild board Kconfig descriptions.
osource "/mnt/c/zephyrproject/zephyr/boards/atmel/sam0/samr21_xpro/Kconfig.sysbuild"
```

## APP_jpsouto/build/Kconfig/soc/Kconfig
```kconfig
# Load Zephyr SoC Kconfig descriptions.
osource "/mnt/c/zephyrproject/zephyr/soc/xlnx/zynqmp/Kconfig"
osource "/mnt/c/zephyrproject/zephyr/soc/xlnx/zynq7000/Kconfig"
osource "/mnt/c/zephyrproject/zephyr/soc/xlnx/versalnet/Kconfig"
osource "/mnt/c/zephyrproject/zephyr/soc/xlnx/versal2/Kconfig"
osource "/mnt/c/zephyrproject/zephyr/soc/xen/Kconfig"
osource "/mnt/c/zephyrproject/zephyr/soc/wch/ch32v/Kconfig"
osource "/mnt/c/zephyrproject/zephyr/soc/ti/simplelink/Kconfig"
osource "/mnt/c/zephyrproject/zephyr/soc/ti/mspm0/Kconfig"
osource "/mnt/c/zephyrproject/zephyr/soc/ti/lm3s6965/Kconfig"
osource "/mnt/c/zephyrproject/zephyr/soc/ti/k3/Kconfig"
osource "/mnt/c/zephyrproject/zephyr/soc/telink/tlsr/Kconfig"
osource "/mnt/c/zephyrproject/zephyr/soc/starfive/jh71xx/Kconfig"
osource "/mnt/c/zephyrproject/zephyr/soc/st/stm32/Kconfig"
osource "/mnt/c/zephyrproject/zephyr/soc/snps/qemu_arc/Kconfig"
osource "/mnt/c/zephyrproject/zephyr/soc/snps/nsim/arc_v/Kconfig"
osource "/mnt/c/zephyrproject/zephyr/soc/snps/nsim/arc_classic/Kconfig"
osource "/mnt/c/zephyrproject/zephyr/soc/snps/hsdk4xd/Kconfig"
osource "/mnt/c/zephyrproject/zephyr/soc/snps/hsdk/Kconfig"
osource "/mnt/c/zephyrproject/zephyr/soc/snps/emsk/Kconfig"
osource "/mnt/c/zephyrproject/zephyr/soc/snps/emsdp/Kconfig"
osource "/mnt/c/zephyrproject/zephyr/soc/snps/arc_iot/Kconfig"
osource "/mnt/c/zephyrproject/zephyr/soc/silabs/Kconfig"
osource "/mnt/c/zephyrproject/zephyr/soc/sifli/sf32/Kconfig"
osource "/mnt/c/zephyrproject/zephyr/soc/sifive/sifive_freedom/Kconfig"
osource "/mnt/c/zephyrproject/zephyr/soc/sensry/Kconfig"
osource "/mnt/c/zephyrproject/zephyr/soc/rockchip/Kconfig"
osource "/mnt/c/zephyrproject/zephyr/soc/renode/riscv_virtual/Kconfig"
osource "/mnt/c/zephyrproject/zephyr/soc/renode/cortex_r8_virtual/Kconfig"
osource "/mnt/c/zephyrproject/zephyr/soc/renesas/smartbond/Kconfig"
osource "/mnt/c/zephyrproject/zephyr/soc/renesas/rz/Kconfig"
osource "/mnt/c/zephyrproject/zephyr/soc/renesas/rx/Kconfig"
osource "/mnt/c/zephyrproject/zephyr/soc/renesas/rcar/Kconfig"
osource "/mnt/c/zephyrproject/zephyr/soc/renesas/ra/Kconfig"
osource "/mnt/c/zephyrproject/zephyr/soc/realtek/ec/Kconfig"
osource "/mnt/c/zephyrproject/zephyr/soc/raspberrypi/rpi_pico/Kconfig"
osource "/mnt/c/zephyrproject/zephyr/soc/quicklogic/eos_s3/Kconfig"
osource "/mnt/c/zephyrproject/zephyr/soc/qemu/virt_riscv/Kconfig"
osource "/mnt/c/zephyrproject/zephyr/soc/qemu/malta/Kconfig"
osource "/mnt/c/zephyrproject/zephyr/soc/openisa/rv32m1/Kconfig"
osource "/mnt/c/zephyrproject/zephyr/soc/openhwgroup/cva6/Kconfig"
osource "/mnt/c/zephyrproject/zephyr/soc/oct/osd32mp15x/Kconfig"
osource "/mnt/c/zephyrproject/zephyr/soc/nxp/s32/Kconfig"
osource "/mnt/c/zephyrproject/zephyr/soc/nxp/rw/Kconfig"
osource "/mnt/c/zephyrproject/zephyr/soc/nxp/mcx/Kconfig"
osource "/mnt/c/zephyrproject/zephyr/soc/nxp/lpc/Kconfig"
osource "/mnt/c/zephyrproject/zephyr/soc/nxp/layerscape/Kconfig"
osource "/mnt/c/zephyrproject/zephyr/soc/nxp/kinetis/Kconfig"
osource "/mnt/c/zephyrproject/zephyr/soc/nxp/imxrt/Kconfig"
osource "/mnt/c/zephyrproject/zephyr/soc/nxp/imx/Kconfig"
osource "/mnt/c/zephyrproject/zephyr/soc/nuvoton/numicro/Kconfig"
osource "/mnt/c/zephyrproject/zephyr/soc/nuvoton/numaker/Kconfig"
osource "/mnt/c/zephyrproject/zephyr/soc/nuvoton/npcx/Kconfig"
osource "/mnt/c/zephyrproject/zephyr/soc/nuvoton/npcm/Kconfig"
osource "/mnt/c/zephyrproject/zephyr/soc/nordic/Kconfig"
osource "/mnt/c/zephyrproject/zephyr/soc/neorv32/Kconfig"
osource "/mnt/c/zephyrproject/zephyr/soc/native/inf_clock/Kconfig"
osource "/mnt/c/zephyrproject/zephyr/soc/microchip/sam/Kconfig"
osource "/mnt/c/zephyrproject/zephyr/soc/microchip/sam/sam_d5x_e5x/Kconfig"
osource "/mnt/c/zephyrproject/zephyr/soc/microchip/pic32c/pic32cm_jh/Kconfig"
osource "/mnt/c/zephyrproject/zephyr/soc/microchip/miv/Kconfig"
osource "/mnt/c/zephyrproject/zephyr/soc/microchip/mec/Kconfig"
osource "/mnt/c/zephyrproject/zephyr/soc/mediatek/mt8xxx/Kconfig"
osource "/mnt/c/zephyrproject/zephyr/soc/lowrisc/opentitan/Kconfig"
osource "/mnt/c/zephyrproject/zephyr/soc/litex/litex_vexriscv/Kconfig"
osource "/mnt/c/zephyrproject/zephyr/soc/ite/ec/Kconfig"
osource "/mnt/c/zephyrproject/zephyr/soc/intel/raptor_lake/Kconfig"
osource "/mnt/c/zephyrproject/zephyr/soc/intel/panther_lake/Kconfig"
osource "/mnt/c/zephyrproject/zephyr/soc/intel/lakemont/Kconfig"
osource "/mnt/c/zephyrproject/zephyr/soc/intel/intel_socfpga_std/Kconfig"
osource "/mnt/c/zephyrproject/zephyr/soc/intel/intel_socfpga/Kconfig"
osource "/mnt/c/zephyrproject/zephyr/soc/intel/intel_niosv/Kconfig"
osource "/mnt/c/zephyrproject/zephyr/soc/intel/intel_ish/Kconfig"
osource "/mnt/c/zephyrproject/zephyr/soc/intel/intel_adsp/Kconfig"
osource "/mnt/c/zephyrproject/zephyr/soc/intel/elkhart_lake/Kconfig"
osource "/mnt/c/zephyrproject/zephyr/soc/intel/atom/Kconfig"
osource "/mnt/c/zephyrproject/zephyr/soc/intel/apollo_lake/Kconfig"
osource "/mnt/c/zephyrproject/zephyr/soc/intel/alder_lake/Kconfig"
osource "/mnt/c/zephyrproject/zephyr/soc/infineon/cat3/Kconfig"
osource "/mnt/c/zephyrproject/zephyr/soc/infineon/cat1c/Kconfig"
osource "/mnt/c/zephyrproject/zephyr/soc/infineon/cat1b/Kconfig"
osource "/mnt/c/zephyrproject/zephyr/soc/infineon/cat1a/Kconfig"
osource "/mnt/c/zephyrproject/zephyr/soc/gd/gd32/Kconfig"
osource "/mnt/c/zephyrproject/zephyr/soc/gaisler/leon3/Kconfig"
osource "/mnt/c/zephyrproject/zephyr/soc/gaisler/gr716a/Kconfig"
osource "/mnt/c/zephyrproject/zephyr/soc/espressif/Kconfig"
osource "/mnt/c/zephyrproject/zephyr/soc/ene/kb1200/Kconfig"
osource "/mnt/c/zephyrproject/zephyr/soc/ene/kb106x/Kconfig"
osource "/mnt/c/zephyrproject/zephyr/soc/efinix/sapphire/Kconfig"
osource "/mnt/c/zephyrproject/zephyr/soc/cdns/xtensa_sample_controller/Kconfig"
osource "/mnt/c/zephyrproject/zephyr/soc/cdns/sample_controller32/Kconfig"
osource "/mnt/c/zephyrproject/zephyr/soc/cdns/dc233c/Kconfig"
osource "/mnt/c/zephyrproject/zephyr/soc/brcm/bcmvk/Kconfig"
osource "/mnt/c/zephyrproject/zephyr/soc/brcm/bcm2712/Kconfig"
osource "/mnt/c/zephyrproject/zephyr/soc/brcm/bcm2711/Kconfig"
osource "/mnt/c/zephyrproject/zephyr/soc/bflb/Kconfig"
osource "/mnt/c/zephyrproject/zephyr/soc/atmel/sam0/Kconfig"
osource "/mnt/c/zephyrproject/zephyr/soc/atmel/sam/Kconfig"
osource "/mnt/c/zephyrproject/zephyr/soc/aspeed/Kconfig"
osource "/mnt/c/zephyrproject/zephyr/soc/arm/Kconfig"
osource "/mnt/c/zephyrproject/zephyr/soc/arm/beetle/Kconfig"
osource "/mnt/c/zephyrproject/zephyr/soc/antmicro/myra/Kconfig"
osource "/mnt/c/zephyrproject/zephyr/soc/andestech/Kconfig"
osource "/mnt/c/zephyrproject/zephyr/soc/amd/acp_6_0/Kconfig"
osource "/mnt/c/zephyrproject/zephyr/soc/ambiq/Kconfig"
osource "/mnt/c/zephyrproject/zephyr/soc/aesc/Kconfig"
osource "/mnt/c/zephyrproject/zephyr/soc/adi/max32/Kconfig"
```

## AppJaqueline/build/Kconfig/boards/Kconfig
```kconfig
# Load Zephyr board Kconfig descriptions.
osource "C:/my-workspace/zephyr/boards/atmel/sam0/samd21_xpro/Kconfig"
```

## AppJaqueline/build/Kconfig/boards/Kconfig.defconfig
```kconfig
# Load Zephyr board defconfig descriptions.
osource "C:/my-workspace/zephyr/boards/atmel/sam0/samd21_xpro/Kconfig.defconfig"
```

## AppJaqueline/build/Kconfig/boards/Kconfig.samd21_xpro
```kconfig
# Load board Kconfig descriptions.
osource "C:/my-workspace/zephyr/boards/atmel/sam0/samd21_xpro/Kconfig.samd21_xpro"
```

## AugustoBalestera_sensor_luminosidade/build/Kconfig/arch/Kconfig
```kconfig
# Load Zephyr Arch Kconfig descriptions.
osource "/home/balestera/zephyrproject/zephyr/arch/rx/Kconfig"
osource "/home/balestera/zephyrproject/zephyr/arch/x86/Kconfig"
osource "/home/balestera/zephyrproject/zephyr/arch/xtensa/Kconfig"
osource "/home/balestera/zephyrproject/zephyr/arch/sparc/Kconfig"
osource "/home/balestera/zephyrproject/zephyr/arch/riscv/Kconfig"
osource "/home/balestera/zephyrproject/zephyr/arch/posix/Kconfig"
osource "/home/balestera/zephyrproject/zephyr/arch/mips/Kconfig"
osource "/home/balestera/zephyrproject/zephyr/arch/arm64/Kconfig"
osource "/home/balestera/zephyrproject/zephyr/arch/arm/Kconfig"
osource "/home/balestera/zephyrproject/zephyr/arch/arc/Kconfig"
```

## AugustoBalestera_sensor_luminosidade/build/Kconfig/boards/Kconfig
```kconfig
# Load Zephyr board Kconfig descriptions.
osource "/home/balestera/zephyrproject/zephyr/boards/qemu/x86/Kconfig"
```

## AugustoBalestera_sensor_luminosidade/build/Kconfig/boards/Kconfig.defconfig
```kconfig
# Load Zephyr board defconfig descriptions.
osource "/home/balestera/zephyrproject/zephyr/boards/qemu/x86/Kconfig.defconfig"
```

## AugustoBalestera_sensor_luminosidade/build/Kconfig/soc/Kconfig
```kconfig
# Load Zephyr SoC Kconfig descriptions.
osource "/home/balestera/zephyrproject/zephyr/soc/xlnx/zynqmp/Kconfig"
osource "/home/balestera/zephyrproject/zephyr/soc/xlnx/zynq7000/Kconfig"
osource "/home/balestera/zephyrproject/zephyr/soc/xlnx/versalnet/Kconfig"
osource "/home/balestera/zephyrproject/zephyr/soc/xlnx/versal2/Kconfig"
osource "/home/balestera/zephyrproject/zephyr/soc/xen/Kconfig"
osource "/home/balestera/zephyrproject/zephyr/soc/wch/ch32v/Kconfig"
osource "/home/balestera/zephyrproject/zephyr/soc/ti/simplelink/Kconfig"
osource "/home/balestera/zephyrproject/zephyr/soc/ti/mspm0/Kconfig"
osource "/home/balestera/zephyrproject/zephyr/soc/ti/lm3s6965/Kconfig"
osource "/home/balestera/zephyrproject/zephyr/soc/ti/k3/Kconfig"
osource "/home/balestera/zephyrproject/zephyr/soc/telink/tlsr/Kconfig"
osource "/home/balestera/zephyrproject/zephyr/soc/starfive/jh71xx/Kconfig"
osource "/home/balestera/zephyrproject/zephyr/soc/st/stm32/Kconfig"
osource "/home/balestera/zephyrproject/zephyr/soc/snps/qemu_arc/Kconfig"
osource "/home/balestera/zephyrproject/zephyr/soc/snps/nsim/arc_v/Kconfig"
osource "/home/balestera/zephyrproject/zephyr/soc/snps/nsim/arc_classic/Kconfig"
osource "/home/balestera/zephyrproject/zephyr/soc/snps/hsdk4xd/Kconfig"
osource "/home/balestera/zephyrproject/zephyr/soc/snps/hsdk/Kconfig"
osource "/home/balestera/zephyrproject/zephyr/soc/snps/emsk/Kconfig"
osource "/home/balestera/zephyrproject/zephyr/soc/snps/emsdp/Kconfig"
osource "/home/balestera/zephyrproject/zephyr/soc/snps/arc_iot/Kconfig"
osource "/home/balestera/zephyrproject/zephyr/soc/silabs/Kconfig"
osource "/home/balestera/zephyrproject/zephyr/soc/sifli/sf32/Kconfig"
osource "/home/balestera/zephyrproject/zephyr/soc/sifive/sifive_freedom/Kconfig"
osource "/home/balestera/zephyrproject/zephyr/soc/sensry/Kconfig"
osource "/home/balestera/zephyrproject/zephyr/soc/rockchip/Kconfig"
osource "/home/balestera/zephyrproject/zephyr/soc/renode/riscv_virtual/Kconfig"
osource "/home/balestera/zephyrproject/zephyr/soc/renode/cortex_r8_virtual/Kconfig"
osource "/home/balestera/zephyrproject/zephyr/soc/renesas/smartbond/Kconfig"
osource "/home/balestera/zephyrproject/zephyr/soc/renesas/rz/Kconfig"
osource "/home/balestera/zephyrproject/zephyr/soc/renesas/rx/Kconfig"
osource "/home/balestera/zephyrproject/zephyr/soc/renesas/rcar/Kconfig"
osource "/home/balestera/zephyrproject/zephyr/soc/renesas/ra/Kconfig"
osource "/home/balestera/zephyrproject/zephyr/soc/realtek/ec/Kconfig"
osource "/home/balestera/zephyrproject/zephyr/soc/raspberrypi/rpi_pico/Kconfig"
osource "/home/balestera/zephyrproject/zephyr/soc/quicklogic/eos_s3/Kconfig"
osource "/home/balestera/zephyrproject/zephyr/soc/qemu/virt_riscv/Kconfig"
osource "/home/balestera/zephyrproject/zephyr/soc/qemu/malta/Kconfig"
osource "/home/balestera/zephyrproject/zephyr/soc/openisa/rv32m1/Kconfig"
osource "/home/balestera/zephyrproject/zephyr/soc/openhwgroup/cva6/Kconfig"
osource "/home/balestera/zephyrproject/zephyr/soc/oct/osd32mp15x/Kconfig"
osource "/home/balestera/zephyrproject/zephyr/soc/nxp/s32/Kconfig"
osource "/home/balestera/zephyrproject/zephyr/soc/nxp/rw/Kconfig"
osource "/home/balestera/zephyrproject/zephyr/soc/nxp/mcx/Kconfig"
osource "/home/balestera/zephyrproject/zephyr/soc/nxp/lpc/Kconfig"
osource "/home/balestera/zephyrproject/zephyr/soc/nxp/layerscape/Kconfig"
osource "/home/balestera/zephyrproject/zephyr/soc/nxp/kinetis/Kconfig"
osource "/home/balestera/zephyrproject/zephyr/soc/nxp/imxrt/Kconfig"
osource "/home/balestera/zephyrproject/zephyr/soc/nxp/imx/Kconfig"
osource "/home/balestera/zephyrproject/zephyr/soc/nuvoton/numicro/Kconfig"
osource "/home/balestera/zephyrproject/zephyr/soc/nuvoton/numaker/Kconfig"
osource "/home/balestera/zephyrproject/zephyr/soc/nuvoton/npcx/Kconfig"
osource "/home/balestera/zephyrproject/zephyr/soc/nuvoton/npcm/Kconfig"
osource "/home/balestera/zephyrproject/zephyr/soc/nordic/Kconfig"
osource "/home/balestera/zephyrproject/zephyr/soc/neorv32/Kconfig"
osource "/home/balestera/zephyrproject/zephyr/soc/native/inf_clock/Kconfig"
osource "/home/balestera/zephyrproject/zephyr/soc/microchip/sam/Kconfig"
osource "/home/balestera/zephyrproject/zephyr/soc/microchip/sam/sama7/Kconfig"
osource "/home/balestera/zephyrproject/zephyr/soc/microchip/sam/sam_d5x_e5x/Kconfig"
osource "/home/balestera/zephyrproject/zephyr/soc/microchip/pic32c/pic32cz_ca/Kconfig"
osource "/home/balestera/zephyrproject/zephyr/soc/microchip/pic32c/pic32cx_sg/Kconfig"
osource "/home/balestera/zephyrproject/zephyr/soc/microchip/pic32c/pic32cm_jh/Kconfig"
osource "/home/balestera/zephyrproject/zephyr/soc/microchip/miv/Kconfig"
osource "/home/balestera/zephyrproject/zephyr/soc/microchip/mec/Kconfig"
osource "/home/balestera/zephyrproject/zephyr/soc/mediatek/mt8xxx/Kconfig"
osource "/home/balestera/zephyrproject/zephyr/soc/lowrisc/opentitan/Kconfig"
osource "/home/balestera/zephyrproject/zephyr/soc/litex/litex_vexriscv/Kconfig"
osource "/home/balestera/zephyrproject/zephyr/soc/ite/ec/Kconfig"
osource "/home/balestera/zephyrproject/zephyr/soc/intel/raptor_lake/Kconfig"
osource "/home/balestera/zephyrproject/zephyr/soc/intel/panther_lake/Kconfig"
osource "/home/balestera/zephyrproject/zephyr/soc/intel/lakemont/Kconfig"
osource "/home/balestera/zephyrproject/zephyr/soc/intel/intel_socfpga_std/Kconfig"
osource "/home/balestera/zephyrproject/zephyr/soc/intel/intel_socfpga/Kconfig"
osource "/home/balestera/zephyrproject/zephyr/soc/intel/intel_niosv/Kconfig"
osource "/home/balestera/zephyrproject/zephyr/soc/intel/intel_ish/Kconfig"
osource "/home/balestera/zephyrproject/zephyr/soc/intel/intel_adsp/Kconfig"
osource "/home/balestera/zephyrproject/zephyr/soc/intel/elkhart_lake/Kconfig"
osource "/home/balestera/zephyrproject/zephyr/soc/intel/atom/Kconfig"
osource "/home/balestera/zephyrproject/zephyr/soc/intel/apollo_lake/Kconfig"
osource "/home/balestera/zephyrproject/zephyr/soc/intel/alder_lake/Kconfig"
osource "/home/balestera/zephyrproject/zephyr/soc/infineon/edge/Kconfig"
osource "/home/balestera/zephyrproject/zephyr/soc/infineon/cat3/Kconfig"
osource "/home/balestera/zephyrproject/zephyr/soc/infineon/cat1c/Kconfig"
osource "/home/balestera/zephyrproject/zephyr/soc/infineon/cat1b/Kconfig"
osource "/home/balestera/zephyrproject/zephyr/soc/infineon/cat1a/Kconfig"
osource "/home/balestera/zephyrproject/zephyr/soc/gd/gd32/Kconfig"
osource "/home/balestera/zephyrproject/zephyr/soc/gaisler/leon3/Kconfig"
osource "/home/balestera/zephyrproject/zephyr/soc/gaisler/gr716a/Kconfig"
osource "/home/balestera/zephyrproject/zephyr/soc/espressif/Kconfig"
osource "/home/balestera/zephyrproject/zephyr/soc/ene/kb1200/Kconfig"
osource "/home/balestera/zephyrproject/zephyr/soc/ene/kb106x/Kconfig"
osource "/home/balestera/zephyrproject/zephyr/soc/egis/Kconfig"
osource "/home/balestera/zephyrproject/zephyr/soc/efinix/sapphire/Kconfig"
osource "/home/balestera/zephyrproject/zephyr/soc/cdns/xtensa_sample_controller/Kconfig"
osource "/home/balestera/zephyrproject/zephyr/soc/cdns/sample_controller32/Kconfig"
osource "/home/balestera/zephyrproject/zephyr/soc/cdns/dc233c/Kconfig"
osource "/home/balestera/zephyrproject/zephyr/soc/brcm/bcmvk/Kconfig"
osource "/home/balestera/zephyrproject/zephyr/soc/brcm/bcm2712/Kconfig"
osource "/home/balestera/zephyrproject/zephyr/soc/brcm/bcm2711/Kconfig"
osource "/home/balestera/zephyrproject/zephyr/soc/bflb/Kconfig"
osource "/home/balestera/zephyrproject/zephyr/soc/atmel/sam0/Kconfig"
osource "/home/balestera/zephyrproject/zephyr/soc/atmel/sam/Kconfig"
osource "/home/balestera/zephyrproject/zephyr/soc/aspeed/Kconfig"
osource "/home/balestera/zephyrproject/zephyr/soc/arm/Kconfig"
osource "/home/balestera/zephyrproject/zephyr/soc/arm/beetle/Kconfig"
osource "/home/balestera/zephyrproject/zephyr/soc/antmicro/myra/Kconfig"
osource "/home/balestera/zephyrproject/zephyr/soc/andestech/Kconfig"
osource "/home/balestera/zephyrproject/zephyr/soc/amd/acp_6_0/Kconfig"
osource "/home/balestera/zephyrproject/zephyr/soc/ambiq/Kconfig"
osource "/home/balestera/zephyrproject/zephyr/soc/aesc/Kconfig"
osource "/home/balestera/zephyrproject/zephyr/soc/adi/max32/Kconfig"
```

## app/build/Kconfig/boards/Kconfig.sysbuild
```kconfig
# Load Sysbuild board Kconfig descriptions.
osource "C:/my-workspace/zephyr/boards/atmel/sam0/samr21_xpro/Kconfig.sysbuild"
```

## drivers/sensor/bno055/Kconfig
```kconfig
config BNO055
    bool "Habilitar driver do sensor Bosch BNO055"
    depends on I2C
    depends on SENSOR
    help
      Habilita o driver para o sensor de orientação IMU BNO055.
```

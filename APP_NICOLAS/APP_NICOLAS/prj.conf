## CMakeLists.txt
```
cmake_minimum_required(VERSION 3.20.0)

find_package(Zephyr REQUIRED HINTS $ENV{ZEPHYR_BASE})
project(APP_NICOLAS)

target_sources(app PRIVATE src/main.c)
```

## prj.conf
```kconfig
# =====================================
# UART + LOG
# =====================================
CONFIG_SERIAL=y
CONFIG_UART_INTERRUPT_DRIVEN=y

CONFIG_PRINTK=y
CONFIG_LOG=y
CONFIG_LOG_DEFAULT_LEVEL=3

CONFIG_MAIN_STACK_SIZE=2048

# =====================================
# BLUETOOTH HCI RAW (apenas isso!)
# =====================================
CONFIG_BT=y
CONFIG_BT_HCI_RAW=y
CONFIG_BT_HCI_RAW_H4=y
```

## boards/samr21_xpro.overlay
```dts
/ {
    chosen {
        zephyr,bt-hci = &bt_hci_uart;
    };
};

/* SERCOM3 é o UART no header EXT1 da SAMR21 Xplained Pro */
&sercom3 {
    compatible = "atmel,sam0-uart";
    status = "okay";

    /* PB00 = PAD0 = TX (txpo = 0)
     * PB01 = PAD1 = RX (rxpo = 1)
     */
    txpo = <0>;
    rxpo = <1>;
    current-speed = <115200>;

    bt_hci_uart: bt_hci_uart {
        compatible = "zephyr,bt-hci-uart";
        status = "okay";
    };
};
```

## src/main.c
```c
#include <zephyr/kernel.h>
#include <zephyr/device.h>
#include <zephyr/drivers/gpio.h>
#include <zephyr/logging/log.h>

LOG_MODULE_REGISTER(app);

static const struct gpio_dt_spec led0 = GPIO_DT_SPEC_GET(DT_ALIAS(led0), gpios);

void process_cmd(const char *cmd)
{
    if (strncmp(cmd, "ping", 4) == 0) {
        printk("pong\n");
    }

    else if (strncmp(cmd, "led on", 6) == 0) {
        gpio_pin_set_dt(&led0, 1);   // ACTIVE_LOW → 1 = OFF
        printk("LED ON\n");
    }

    else if (strncmp(cmd, "led off", 7) == 0) {
        gpio_pin_set_dt(&led0, 0);   // ACTIVE_LOW → 0 = ON
        printk("LED OFF\n");
    }

    else {
        printk("unknown command: %s\n", cmd);
    }
}

int main(void)
{
    printk("SAMR21 BLE Remote Control\n");

    if (!device_is_ready(led0.port)) {
        printk("LED0 not ready!\n");
        return 0;
    }

    gpio_pin_configure_dt(&led0, GPIO_OUTPUT_INACTIVE);

    printk("Ready.\n");

    while (1) {
        k_msleep(1000);
    }
}
```

## src/display_log_backend.c
```c
#include <zephyr/kernel.h>
#include <zephyr/logging/log_backend.h>
#include <zephyr/logging/log_output.h>
#include <zephyr/device.h>
#include <zephyr/drivers/display.h>

LOG_MODULE_REGISTER(display_logger, LOG_LEVEL_INF);

// buffer temporário para o texto
static uint8_t buf[256];

// instancia o output
static void write_to_display(uint8_t *data, size_t len)
{
    const struct device *display_dev = DEVICE_DT_GET_ANY(zephyr_display);

    if (!device_is_ready(display_dev)) {
        return;
    }

    /* --- EXEMPLO DE IMPRESSÃO NO DISPLAY ---
       Aqui você vai substituir pela sua API !!!
    */

    /* Exemplo genérico (não funciona sem sua API):
    display_write_string(display_dev, data, len);
    */

    /* só pra visualizar no console, debug */
    printk("DISPLAY: %s\n", data);
}

LOG_OUTPUT_DEFINE(display_output, write_to_display, buf, sizeof(buf));

static void display_log_process(const struct log_backend *const backend,
                                union log_msg_generic *msg)
{
    uint32_t flags = LOG_OUTPUT_FLAG_FORMAT_SYST |
                     LOG_OUTPUT_FLAG_LEVEL |
                     LOG_OUTPUT_FLAG_TIMESTAMP;

    log_output_msg_process(&display_output, &msg->log, flags);
}

static void display_log_put(const struct log_backend *const backend,
                            struct log_msg *msg)
{
    log_msg_get(msg);
    display_log_process(backend, (union log_msg_generic *)msg);
    log_msg_put(msg);
}

static void display_log_panic(const struct log_backend *const backend)
{
    log_output_flush(&display_output);
}

const struct log_backend_api display_log_backend_api = {
    .put = display_log_put,
    .panic = display_log_panic,
};

LOG_BACKEND_DEFINE(display_backend, display_log_backend_api, true);
```

## CMakeLists.txt
```
cmake_minimum_required(VERSION 3.20.0)
find_package(Zephyr REQUIRED HINTS $ENV{ZEPHYR_BASE})
project(APP_gfschuster)

target_include_directories(app PRIVATE include)

target_sources(app PRIVATE
    src/main.c
    src/sensor_temp.c
    src/sensor_lux.c
    src/sensor_humidity.c
    src/data_center.c
)
```

## prj.conf
```kconfig
# Habilita recursos básicos
CONFIG_STDOUT_CONSOLE=y
CONFIG_MAIN_STACK_SIZE=2048
CONFIG_PRINTK=y
CONFIG_SYSTEM_WORKQUEUE_STACK_SIZE=2048
CONFIG_NEWLIB_LIBC=y
```

## src/main.c
```c
#include <zephyr/kernel.h>
#include "app.h"

// Threads (stack, prioridade e delay)
K_THREAD_DEFINE(temp_tid, 1024, sensor_temp_thread, NULL, NULL, NULL, 2, 0, 0);
K_THREAD_DEFINE(lux_tid, 1024, sensor_lux_thread, NULL, NULL, NULL, 2, 0, 0);
K_THREAD_DEFINE(hum_tid, 1024, sensor_humidity_thread, NULL, NULL, NULL, 2, 0, 0);
K_THREAD_DEFINE(center_tid, 2048, data_center_thread, NULL, NULL, NULL, 1, 0, 0);
```

## include/app.h
```c
#ifndef APP_H
#define APP_H

#include <zephyr/kernel.h>

// Estrutura de mensagem genérica
typedef struct {
    char tipo[16];
    int valor;
} sensor_msg_t;

#define MSGQ_MAX_MSG 10
#define MSGQ_ALIGN   4

extern struct k_msgq sensor_msgq;

// Protótipos das threads
void data_center_thread(void *, void *, void *);
void sensor_temp_thread(void *, void *, void *);
void sensor_lux_thread(void *, void *, void *);
void sensor_humidity_thread(void *, void *, void *);

#endif
```

## src/data_center.c
```c
#include <zephyr/kernel.h>
#include <zephyr/sys/printk.h>
#include <string.h>
#include "app.h"

// Fila global
K_MSGQ_DEFINE(sensor_msgq, sizeof(sensor_msg_t), MSGQ_MAX_MSG, MSGQ_ALIGN);

// Acumuladores
static int temp_acc = 0, lux_acc = 0, hum_acc = 0;
static int temp_count = 0, lux_count = 0, hum_count = 0;

void data_center_thread(void *a, void *b, void *c)
{
    sensor_msg_t msg;
    print_header();

    while (1) {
        if (k_msgq_get(&sensor_msgq, &msg, K_FOREVER) == 0) {
            if (strcmp(msg.tipo, "TEMP") == 0) {
                temp_acc += msg.valor;
                temp_count++;
            } else if (strcmp(msg.tipo, "LUX") == 0) {
                lux_acc += msg.valor;
                lux_count++;
            } else if (strcmp(msg.tipo, "HUM") == 0) {
                hum_acc += msg.valor;
                hum_count++;
            }

            if (temp_count > 0 && lux_count > 0 && hum_count > 0) {
                int temp_med = temp_acc / temp_count;
                int lux_med = lux_acc / lux_count;
                int hum_med = hum_acc / hum_count;
                uint32_t tempo = k_uptime_get_32() / 1000;

                printk("%d,%d,%d\n", temp_med, lux_med, hum_med);

                temp_acc = lux_acc = hum_acc = 0;
                temp_count = lux_count = hum_count = 0;
            }
        }

        k_msleep(200);
    }
}
```

## src/sensor_humidity.c
```c
#include <zephyr/kernel.h>
#include <stdlib.h>
#include <string.h>
#include "app.h"

void sensor_humidity_thread(void *a, void *b, void *c)
{
    sensor_msg_t msg;

    while (1) {
        msg.valor = 40 + rand() % 40; // 40% a 79%
        strcpy(msg.tipo, "HUM");
        k_msgq_put(&sensor_msgq, &msg, K_NO_WAIT);
        k_msleep(1500);
    }
}
```

## src/sensor_lux.c
```c
#include <zephyr/kernel.h>
#include <stdlib.h>
#include <string.h>
#include "app.h"

void sensor_lux_thread(void *a, void *b, void *c)
{
    sensor_msg_t msg;

    while (1) {
        msg.valor = rand() % 1000; // 0 a 999 lx
        strcpy(msg.tipo, "LUX");
        k_msgq_put(&sensor_msgq, &msg, K_NO_WAIT);
        k_msleep(1200);
    }
}
```

## src/sensor_temp.c
```c
#include <zephyr/kernel.h>
#include <stdlib.h>
#include <string.h>
#include "app.h"

void sensor_temp_thread(void *a, void *b, void *c)
{
    sensor_msg_t msg;

    while (1) {
        msg.valor = 20 + rand() % 10; // 20°C a 29°C
        strcpy(msg.tipo, "TEMP");
        k_msgq_put(&sensor_msgq, &msg, K_NO_WAIT);
        k_msleep(1000);
    }
}
```
